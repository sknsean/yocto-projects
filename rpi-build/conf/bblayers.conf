## rpi-build/conf/bblayers.conf
```bitbake
# POKY_BBLAYERS_CONF_VERSION is increased each time build/conf/bblayers.conf
# changes incompatibly
POKY_BBLAYERS_CONF_VERSION = "2"

BBPATH = "${TOPDIR}"
BBFILES ?= ""

BBLAYERS ?= " \
  /home/skn/development/heat/yocto-projects/poky/meta \
  /home/skn/development/heat/yocto-projects/poky/meta-poky \
  /home/skn/development/heat/yocto-projects/poky/meta-yocto-bsp \
  /home/skn/development/heat/yocto-projects/meta-raspberrypi \
  /home/skn/development/heat/yocto-projects/rpi-build \
  /home/skn/development/heat/yocto-projects/meta-openembedded/meta-oe \
  /home/skn/development/heat/yocto-projects/meta-openembedded/meta-multimedia \
  /home/skn/development/heat/yocto-projects/meta-rauc \
  /home/skn/development/heat/yocto-projects/meta-intel-iot-middleware \
  "
```

## rpi-build/conf/layer.conf
```bitbake
# We have a conf and classes directory, add to BBPATH
BBPATH =. "${LAYERDIR}:"

# We have recipes-* directories, add to BBFILES
BBFILES += "${LAYERDIR}/recipes-*/*/*.bb \
            ${LAYERDIR}/recipes-*/*/*.bbappend"

BBFILE_COLLECTIONS += "rpibuild"
BBFILE_PATTERN_rpibuild = "^${LAYERDIR}/"
BBFILE_PRIORITY_rpibuild = "1"
```
